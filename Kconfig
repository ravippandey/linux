## Kconfig
```kconfig
#
# For a description of the syntax of this configuration file,
# see Documentation/kbuild/kconfig-language.txt.
#
mainmenu "Linux/$ARCH $KERNELVERSION Kernel Configuration"

config SRCARCH
	string
	option env="SRCARCH"

config MY_DEBUG
	bool "Select to get some DEFINE"
	default y
	help
		This is a config define that is sent to both make
		and defined in a config.h header.

source "arch/$SRCARCH/Kconfig"
```
